## boards/shields/forager_plus/Kconfig.defconfig
```kconfig
if SHIELD_FORAGER_PLUS_LEFT

config ZMK_KEYBOARD_NAME
    default "Forager+"

config ZMK_SPLIT_ROLE_CENTRAL
    default y

config ZMK_STUDIO
    default y

endif

if SHIELD_FORAGER_PLUS_LEFT || SHIELD_FORAGER_PLUS_RIGHT

config ZMK_SPLIT
    default y

endif
```

## boards/shields/forager_plus/Kconfig.shield
```kconfig
config SHIELD_FORAGER_PLUS_LEFT
    def_bool $(shields_list_contains,forager_plus_left)

config SHIELD_FORAGER_PLUS_RIGHT
    def_bool $(shields_list_contains,forager_plus_right)
```

## config/west.yml
```yaml
manifest:
  defaults:
    revision: v0.3 # Pin everything to v0.3

  remotes:
    - name: zmkfirmware
      url-base: https://github.com/zmkfirmware
    - name: caksoylar
      url-base: https://github.com/caksoylar
  projects:
    - name: zmk
      remote: zmkfirmware
      import: app/west.yml
    - name: zmk-rgbled-widget
      remote: caksoylar

    - name: zephyr
      remote: zmkfirmware
      revision: v3.5.0+zmk-fixes
      clone-depth: 1
      import:
        name-allowlist:
          - cmsis
          - hal_nordic
          - hal_rpi_pico
          - hal_stm32
          - lvgl
          - tinycrypt
  self:
    path: config
```
