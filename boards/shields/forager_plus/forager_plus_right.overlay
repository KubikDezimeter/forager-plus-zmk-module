#include "forager_plus.dtsi"

&default_transform {
    col-offset = <20>;
};

/ {
    chosen {
        zmk,kscan = &kscan0;
    };

    kscan0: kscan_0 {
        compatible = "zmk,kscan-gpio-direct";
        wakeup-source;

        input-gpios
            = <&gpio0  2 (GPIO_ACTIVE_LOW | GPIO_PULL_UP)>
            , <&gpio0 15 (GPIO_ACTIVE_LOW | GPIO_PULL_UP)>
            , <&gpio0  3 (GPIO_ACTIVE_LOW | GPIO_PULL_UP)>
            , <&gpio0 19 (GPIO_ACTIVE_LOW | GPIO_PULL_UP)>
            , <&gpio0 28 (GPIO_ACTIVE_LOW | GPIO_PULL_UP)>
            , <&gpio1  1 (GPIO_ACTIVE_LOW | GPIO_PULL_UP)>
            , <&gpio0 29 (GPIO_ACTIVE_LOW | GPIO_PULL_UP)>
            , <&gpio0  9 (GPIO_ACTIVE_LOW | GPIO_PULL_UP)>
            , <&gpio0  4 (GPIO_ACTIVE_LOW | GPIO_PULL_UP)>
            , <&gpio0 10 (GPIO_ACTIVE_LOW | GPIO_PULL_UP)>
            , <&gpio0  5 (GPIO_ACTIVE_LOW | GPIO_PULL_UP)>
            , <&gpio0 31 (GPIO_ACTIVE_LOW | GPIO_PULL_UP)>
            , <&gpio1 11 (GPIO_ACTIVE_LOW | GPIO_PULL_UP)>
            , <&gpio1 12 (GPIO_ACTIVE_LOW | GPIO_PULL_UP)>
            , <&gpio1  3 (GPIO_ACTIVE_LOW | GPIO_PULL_UP)>
            , <&gpio1 13 (GPIO_ACTIVE_LOW | GPIO_PULL_UP)>
            , <&gpio1  5 (GPIO_ACTIVE_LOW | GPIO_PULL_UP)>
            , <&gpio1 14 (GPIO_ACTIVE_LOW | GPIO_PULL_UP)>
            , <&gpio1  7 (GPIO_ACTIVE_LOW | GPIO_PULL_UP)>
            , <&gpio1 15 (GPIO_ACTIVE_LOW | GPIO_PULL_UP)>
            ;
    };
};
